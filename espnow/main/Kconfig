## espnow/main/Kconfig
```kconfig
choice
    prompt "Select Hub / Station Mode"
    help
      Choose one of the available modes.

config HUB_MODE
    bool "Hub Mode"

config STATION_MODE
    bool "Station Mode"

endchoice
```

## espnow/modules/stats/Kconfig
```kconfig
menu "Stats Configuration"

config MY_ENABLE_RTOS_STATS
    bool "Enable FreeRTOS runtime stats using esp_timer"
    default n
    help
        When enabled, activates FreeRTOS run-time stats using esp_timer.
    select FREERTOS_GENERATE_RUN_TIME_STATS
    select FREERTOS_RUN_TIME_STATS_USING_ESP_TIMER

endmenu
```
